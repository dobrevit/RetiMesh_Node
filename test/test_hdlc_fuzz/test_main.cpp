// SPDX-License-Identifier: GPL-3.0-or-later
// Copyright (C) 2026 Dobrev IT Ltd
//
// This file is part of RetiMesh Node. See LICENSE.
//
// A deterministic fuzzer for the RNS TCP deframer (HDLC.h).
//
// test_hdlc next door pins named corruptions: a dangling escape, a FLAG inside
// an escape pair, a frame one byte over the MTU. Each was written because
// somebody thought of it. This suite exists for the ones nobody thought of.
// The deframer's whole job is to survive bytes it did not choose — a TCP
// listener is fed by whoever connects to it, and port 4242 is reachable by
// anything on the network — so the interesting inputs are the ones no author
// would write down: a valid frame with three bits flipped, a stream that is
// nothing but escapes, a run that crosses the MTU by one byte in the middle of
// an escape pair.
//
// Why properties and not recorded outputs. There is no oracle for what a
// corrupted stream *should* decode to; any expected-bytes table would just be
// this implementation's current behaviour written down twice, and would have to
// be regenerated the moment the parser changed, which is exactly when a test is
// supposed to object. So nothing here asserts what came out. It asserts the
// six things that must hold whatever comes out:
//
//   1. Recovery. After any prefix at all, one well-formed frame decodes byte
//      for byte. This is the acceptance criterion, and it is provable from the
//      code rather than hopeful: feed()'s FLAG branch unconditionally clears
//      escaped, overflow and len before returning, so no reachable parser state
//      can outlive a FLAG. A deframer that eats a malformed stream and then
//      stops decoding is a remote denial of service on a Transport node.
//   2. The MTU boundary holds in both directions: every frame handed to the
//      sink is 1..RNS_MTU bytes. Nothing longer, and never the empty frame that
//      back-to-back FLAGs would otherwise produce.
//   3. oversized() is a counter, not a signal: monotonic, ticking at most once
//      per byte, and only ever on a FLAG — because the drop is counted when the
//      closing FLAG arrives, not when the buffer fills — and never before the
//      second FLAG byte of a deframer's life, because dropped++ needs overflow,
//      overflow is only reachable with inFrame set, and inFrame is only set by
//      an earlier FLAG. Bytes that were never inside a frame are not a dropped
//      frame. Operators read this number to tell "peer speaks a bigger MTU"
//      from "peer is silent"; a counter that also ticks on inter-frame garbage
//      would answer neither.
//   4. Delivering and dropping are exclusive. A single feed() may hand a frame
//      to the sink or count a drop, never both: in the parser they are the two
//      arms of one `overflow` test on the same closing FLAG. This is the
//      property that stops the truncated head of an oversized frame being
//      delivered as if it were whole — the path by which a desynced or hostile
//      peer's garbage would reach the RNS stack wearing the shape of a
//      legitimate MTU-sized packet. The length bound in (2) cannot see it: buf
//      is RNS_MTU bytes, so what a truncated delivery hands over is exactly 500
//      bytes and passes.
//   5. reset() empties the parser and keeps the counter. A well-formed frame
//      fed straight after reset() decodes to itself and to nothing else — the
//      leading FLAG has no pending partial to flush — while oversized() carries
//      its total across, because that total counts drops since the deframer was
//      created and a resync is not a new deframer. It has no caller in src/ yet
//      (the serial interface is what will need it), which is exactly why the
//      contract is pinned here rather than after something depends on it.
//   6. Memory safety, to the extent a host build without sanitizers can show
//      it: the Deframer sits between two guard bands, and they are checked
//      after every iteration. This is a heuristic and is treated as one — the
//      real evidence is `pio test -e native_sanitize`, which builds these two
//      suites with -fsanitize=address,undefined. Which sanitizer is not a
//      detail: the overflow a regression here would produce writes one past the
//      end of buf[], which lands inside the object's own alignment padding,
//      crosses no ASan redzone, and leaves ASan silent. UBSan's array-bounds is
//      the check that fires. docs/development.md carries the command.
//
// Determinism. There is no rand(), no <random>, no clock and no entropy of any
// kind here: the corpus is generated by a splitmix32 written out below, and
// every stream is seeded from (seed, generator, iteration) rather than from the
// running state of the PRNG, so iteration 4711 is the same bytes whether the
// run does five thousand iterations or five million. A fuzz test whose input
// depends on the runner is a flaky test, and a flaky test in CI teaches people
// to re-run rather than to read. Every failure message carries the seed, the
// generator and the iteration, which together name the exact stream; argv[1]
// and argv[2] override the iteration count and the seed, so a developer can run
// a budget hundreds of times larger than CI's without editing anything.
#include <unity.h>
#include <stdarg.h>
#include <stdio.h>
#include <stdlib.h>
#include <string.h>
#include <vector>
#include "HDLC.h"

// ---------------------------------------------------------------------------
// The corpus generator
// ---------------------------------------------------------------------------

// splitmix32. Six lines, no state beyond one word, and the same sequence on
// every host and every compiler — which is the entire requirement. Same reason
// test_radio_selftest builds its digests from an arithmetic seed rather than
// asking the platform for bytes.
struct Rng {
  uint32_t s;
  explicit Rng(uint32_t seed) : s(seed) {}
  uint32_t next() {
    uint32_t z = (s += 0x9E3779B9u);
    z = (z ^ (z >> 16)) * 0x21F0AAADu;
    z = (z ^ (z >> 15)) * 0x735A2D97u;
    return z ^ (z >> 15);
  }
  // Modulo bias is irrelevant here: these numbers pick corpus shapes, they are
  // not a statistical claim.
  uint32_t below(uint32_t n) { return next() % n; }
  uint32_t range(uint32_t lo, uint32_t hi) { return lo + below(hi - lo + 1); }
  uint8_t  byte() { return (uint8_t)(next() >> 24); }
  bool     chance(uint32_t oneIn) { return below(oneIn) == 0; }
};

// The seed CI runs. Changing it changes the corpus, so it is a constant with a
// name and not a literal buried in main(): if this ever has to move because the
// old corpus went stale, that is a reviewable edit.
static constexpr uint32_t kDefaultSeed = 0x7E7D5E5Du;

// Per generator. Three stream generators plus the round-trip corpus at this
// count, streams up to kMaxStream, is the budget the CI `tests` job pays for;
// measured, not estimated. argv[1] raises it for a local run.
static constexpr unsigned kDefaultIterations = 15000;
static constexpr size_t   kMaxStream         = 4096;

// Each stream's PRNG is seeded from the run seed plus its coordinates, so no
// stream depends on how many streams ran before it.
static uint32_t streamSeed(uint32_t seed, unsigned gen, unsigned iter) {
  Rng mix(seed ^ (gen * 0x85EBCA6Bu) ^ (iter * 0xC2B2AE35u));
  mix.next();
  return mix.next();
}

// The generators, by the name a failure prints. kGenCount is derived from the
// table rather than written down again, so the bounds guard in ctx() cannot
// drift from it when a generator is added.
static const char* kGenName[] = { "random-bytes", "mutated-frame", "escape-alphabet",
                                  "round-trip-corpus" };
static constexpr unsigned kGenCount     = sizeof(kGenName) / sizeof(*kGenName);
static constexpr unsigned kGenRoundTrip = 3;   // index into kGenName above

static unsigned gIterations = kDefaultIterations;
static uint32_t gSeed       = kDefaultSeed;
// gGen >= kGenCount means "not inside a seeded corpus run": the fixed-payload
// round-trip cases are not drawn from the corpus, and printing coordinates for
// them would name a stream that had nothing to do with the failure.
static unsigned gGen        = kGenCount;
static unsigned gIter       = 0;   // which iteration of the generator
static size_t   gByte       = 0;   // how far into the stream we are; offsets at
                                   // or past the stream length are inside the
                                   // well-formed frame fed after it

// Formats into a buffer the caller owns, and only on the failure path: the
// happy path evaluates a condition and nothing else, and two messages can never
// alias the way one shared static would. Every corpus failure names the single
// stream that produced it — same seed and a budget at least this large
// reproduces it exactly, on any host.
static constexpr size_t kMsgLen = 384;
__attribute__((format(printf, 3, 4)))
static const char* ctx(char* buf, size_t cap, const char* fmt, ...) {
  va_list ap;
  va_start(ap, fmt);
  const int n = vsnprintf(buf, cap, fmt, ap);
  va_end(ap);
  size_t used = (n < 0) ? 0 : (size_t)n;
  if (used >= cap) used = cap - 1;
  if (gGen < kGenCount)
    snprintf(buf + used, cap - used,
             "  [seed=0x%08X gen=%u(%s) iter=%u byte=%zu]  "
             "reproduce: run this test binary with args '%u 0x%08X'",
             gSeed, gGen, kGenName[gGen], gIter, gByte, gIterations, gSeed);
  return buf;
}

// The message is printf-formatted, so a failure can carry the numbers that made
// it interesting; TEST_FAIL_MESSAGE stays at the assertion site so the reported
// line is the one that failed. Unity prints the message before it bails, so a
// buffer local to the failing statement outlives its only use.
#define FUZZ_ASSERT(cond, ...)                                             \
  do {                                                                     \
    if (!(cond)) {                                                         \
      char fuzzMsg_[kMsgLen];                                              \
      TEST_FAIL_MESSAGE(ctx(fuzzMsg_, sizeof(fuzzMsg_), __VA_ARGS__));     \
    }                                                                      \
  } while (0)

// ---------------------------------------------------------------------------
// Guard bands
// ---------------------------------------------------------------------------

// The Deframer's buf[] is a fixed array inside the object, so a write past its
// end lands in the bytes that follow the object. Sandwiching it between two
// filled arrays turns that into an assertion this build can make. It is not
// proof, and the overflow a regression here would produce is precisely the case
// it misses: one past the end of buf[] is still inside the Deframer, in the
// alignment padding before `len`, so neither band moves and no ASan redzone is
// crossed either. `pio test -e native_sanitize` is what covers that, through
// UBSan's array-bounds. The bands cost one memcmp-shaped loop per iteration and
// do catch the wilder kind of write, so they are here anyway.
struct GuardedDeframer {
  static constexpr size_t  kGuard   = 64;
  static constexpr uint8_t kPattern = 0xA5;
  uint8_t        before[kGuard];
  HDLC::Deframer d;
  uint8_t        after[kGuard];
  GuardedDeframer() {
    for (size_t i = 0; i < kGuard; i++) before[i] = after[i] = kPattern;
  }
  bool guardsIntact() const {
    for (size_t i = 0; i < kGuard; i++)
      if (before[i] != kPattern || after[i] != kPattern) return false;
    return true;
  }
};

// ---------------------------------------------------------------------------
// Generators
// ---------------------------------------------------------------------------

// A payload for framing: either uniform bytes, or bytes drawn mostly from the
// two that escape, so that half the corpus's frames are escape-dense.
static std::vector<uint8_t> randomPayload(Rng& r, size_t maxLen) {
  const size_t n = r.range(1, (uint32_t)maxLen);
  const bool escapeDense = r.below(2) == 0;
  std::vector<uint8_t> p(n);
  for (size_t i = 0; i < n; i++) {
    if (!escapeDense) { p[i] = r.byte(); continue; }
    switch (r.below(4)) {
      case 0:  p[i] = HDLC::FLAG; break;
      case 1:  p[i] = HDLC::ESC;  break;
      case 2:  p[i] = (uint8_t)(r.below(2) ? 0x5D : 0x5E); break;
      default: p[i] = r.byte();
    }
  }
  return p;
}

// Generator 0 — uniform noise. The unstructured case: a non-RNS client talking
// its own protocol at port 4242, or a link that desynced. FLAG turns up once
// every 256 bytes on average, so this generator produces frames in the low
// hundreds of bytes and crosses the MTU often enough to exercise the drop path.
static std::vector<uint8_t> genRandomBytes(Rng& r) {
  std::vector<uint8_t> s(r.below(kMaxStream + 1));
  for (size_t i = 0; i < s.size(); i++) s[i] = r.byte();
  return s;
}

// Generator 1 — a frame this firmware itself produced, then damaged. This is
// the corruption a real link delivers: the sender was conforming and something
// between the two ends flipped, dropped or duplicated bytes. One to three
// mutations, because a single one keeps the stream recognisably a frame while
// three can move a FLAG, split an escape pair and change a length at once.
static std::vector<uint8_t> genMutatedFrame(Rng& r) {
  const std::vector<uint8_t> payload = randomPayload(r, RNS_MTU);
  std::vector<uint8_t> s(HDLC::frameCapacity(payload.size()));
  const size_t n = HDLC::frame(payload.data(), payload.size(), s.data(), s.size());
  s.resize(n);

  const unsigned mutations = r.range(1, 3);
  for (unsigned m = 0; m < mutations; m++) {
    const size_t pos = r.below((uint32_t)s.size());
    switch (r.below(3)) {
      case 0:  s[pos] ^= (uint8_t)(1u << r.below(8)); break;             // flip a bit
      case 1:  if (s.size() > 1) s.erase(s.begin() + (long)pos); break;  // drop a byte
      default: s.insert(s.begin() + (long)pos, r.byte());                // inject a byte
    }
  }
  return s;
}

// Generator 2 — the alphabet the state machine actually lives in. What this
// buys is precision, not reachability: generator 0 gets to all of these shapes
// on its own, because inter-FLAG gaps in uniform noise are geometric with mean
// 256, so a gap longer than the MTU has probability (255/256)^500 ~ 0.14 and
// 40% of its streams already drop at least one oversized frame — 24021 of 60000
// generator-0 streams, and 39.7% at the CI budget. What uniform noise cannot do
// is land on a length. Drawing FLAG-free runs from RNS_MTU +/- 3 concentrates
// decoded lengths on 497..503, which is why some 97% of the exactly-500-byte
// frames decoded out of the corpus streams — the boundary case that must be
// delivered rather than dropped — come from this generator rather than by
// accident. The pairs are the same story: 7D 7D is one position in 65536 of
// uniform noise, so generator 0 makes a few hundred of them across a run this
// size — rare per position, not absent — while here they are the common case.
// Chunks, not bytes, because the MTU boundary is a length property: a run drawn
// from either side of RNS_MTU puts the overflow flag on and off inside frames
// that are otherwise escape soup.
static std::vector<uint8_t> genEscapeAlphabet(Rng& r) {
  std::vector<uint8_t> s;
  s.reserve(kMaxStream);
  const size_t target = r.below(kMaxStream + 1);
  while (s.size() < target) {
    const uint32_t pick = r.below(100);
    if (pick < 22)      s.push_back(HDLC::FLAG);
    else if (pick < 52) s.push_back(HDLC::ESC);
    else if (pick < 67) s.push_back(0x5D);
    else if (pick < 82) s.push_back(0x5E);
    else if (pick < 94) s.push_back(r.byte());
    else {
      // A run with no FLAG in it, sized either side of the MTU or short.
      const size_t run = r.chance(2) ? r.range(RNS_MTU - 3, RNS_MTU + 3)
                                     : r.range(1, 48);
      for (size_t i = 0; i < run && s.size() < kMaxStream; i++) {
        uint8_t b = r.byte();
        if (b == HDLC::FLAG) b = 0x00;   // the point of a run is that it has none
        s.push_back(b);
      }
    }
    if (s.size() >= kMaxStream) break;
  }
  return s;
}

// ---------------------------------------------------------------------------
// The oracles
// ---------------------------------------------------------------------------

// One byte's worth of contract, in one place. Every byte fed to the deframer
// goes through here — the corpus stream's and the well-formed frame's after it
// alike — because "what must hold per byte" is one rule and a second copy of it
// drifts. It also matters which bytes those are: of the streams that reach the
// recovery frame without an intervening reset() — the only ones where that
// flush is observable — 45.8% still hold a deliverable partial when its leading
// FLAG arrives; 37.4% of all streams hold one at the end of the stream, before
// the reset that some of them then take. That one byte flushes a frame 30% of
// the time — 54823 flushes at 60000 iterations per generator — where a byte
// drawn from the streams themselves flushes about half a percent of the time.
// Checking the stream and exempting the recovery would leave the corpus's
// heaviest flush unasserted.
class CheckedFeeder {
public:
  CheckedFeeder(GuardedDeframer& g, std::vector<std::vector<uint8_t>>& frames)
      : g_(g), frames_(frames) {}

  void feed(uint8_t b) {
    const size_t   framesBefore = frames_.size();
    const uint32_t before       = g_.d.oversized();
    if (b == HDLC::FLAG) flagsFed_++;
    g_.d.feed(b, [&](const uint8_t* p, size_t n) { frames_.emplace_back(p, p + n); });
    const size_t   produced = frames_.size() - framesBefore;
    const uint32_t now      = g_.d.oversized();

    // (2) The MTU boundary, on every frame this byte produced.
    for (size_t f = framesBefore; f < frames_.size(); f++) {
      FUZZ_ASSERT(frames_[f].size() >= 1, "the deframer emitted an empty frame");
      FUZZ_ASSERT(frames_[f].size() <= RNS_MTU,
                  "the deframer emitted a frame of %zu bytes, over the MTU", frames_[f].size());
    }
    // A single byte closes at most one frame.
    FUZZ_ASSERT(produced <= 1, "one byte emitted %zu frames", produced);

    // (3) oversized() is monotonic, ticks at most once per byte, and only on a
    // FLAG — the drop is counted at the closing FLAG, not when the buffer fills.
    FUZZ_ASSERT(now >= before, "oversized() went backwards");
    if (now != before) {
      FUZZ_ASSERT(now == before + 1, "oversized() moved by %u on one byte", now - before);
      FUZZ_ASSERT(b == HDLC::FLAG, "oversized() ticked on 0x%02X, which is not a FLAG", b);
      // Counting a drop needs overflow, which needs inFrame, which needs an
      // earlier FLAG — so the earliest a legitimate tick can happen is on the
      // second FLAG this deframer has ever seen. A tick on the first one means
      // bytes that were never inside a frame were counted as a dropped frame.
      FUZZ_ASSERT(flagsFed_ >= 2,
                  "oversized() ticked on FLAG number %u, before a frame could have opened",
                  flagsFed_);
      // (4) The drop and the delivery are the two arms of one test on the same
      // closing FLAG. Doing both means an oversized frame was truncated to
      // RNS_MTU bytes and handed over as well as counted.
      FUZZ_ASSERT(produced == 0, "one byte both delivered a frame and counted it as dropped");
    }
  }

  // (5) reset() clears the parser and deliberately keeps the lifetime drop
  // count; flagsFed_ is a lifetime count for the same reason, so it stays too.
  void reset() {
    const uint32_t before = g_.d.oversized();
    g_.d.reset();
    FUZZ_ASSERT(g_.d.oversized() == before, "reset() moved the oversized() counter");
  }

private:
  GuardedDeframer&                   g_;
  std::vector<std::vector<uint8_t>>& frames_;
  uint32_t                           flagsFed_ = 0;
};

// Feed one stream byte by byte, asserting the invariants that must hold for
// every byte of every stream, then prove the deframer still works.
static void runOneStream(const std::vector<uint8_t>& stream, Rng& r) {
  GuardedDeframer g;
  std::vector<std::vector<uint8_t>> frames;
  CheckedFeeder feeder(g, frames);

  // A share of streams exercise reset() as well: it is the port-level resync,
  // reachable by no sequence of bytes, and nothing in src/ calls it yet —
  // RetiTransportServer gives each connection its own Deframer and destroys the
  // whole ClientCtx on disconnect. That is the reason to fuzz it, not a reason
  // not to: an untested public method is one the first caller inherits on
  // trust. Interleaved at random offsets, because a clear that missed a field
  // would show by where it landed — mid escape pair, mid overflow, between a
  // FLAG and the first payload byte.
  const bool useReset = r.chance(3);

  for (size_t i = 0; i < stream.size(); i++) {
    gByte = i;
    if (useReset && r.chance(256)) feeder.reset();
    feeder.feed(stream[i]);
  }
  gByte = stream.size();

  // (1) Recovery — the acceptance criterion. Whatever state the stream above
  // left behind, one well-formed frame must come back out whole. Its leading
  // FLAG may first flush a frame the stream left open, which is legitimate and
  // is the only other emission allowed here.
  const std::vector<uint8_t> payload = randomPayload(r, RNS_MTU);
  std::vector<uint8_t> good(HDLC::frameCapacity(payload.size()));
  const size_t goodLen = HDLC::frame(payload.data(), payload.size(), good.data(), good.size());
  FUZZ_ASSERT(goodLen > 0, "HDLC::frame() refused a buffer of exactly frameCapacity()");

  // (5) On the reset streams the recovery frame follows a reset, which is the
  // half of reset()'s contract that bites: an emptied parser has no pending
  // partial, so the frame's leading FLAG cannot flush one and exactly one frame
  // must come out. Two would mean reset() left the previous frame in place.
  if (useReset) feeder.reset();

  // The same "exactly one" holds without a reset whenever the parser provably
  // holds no deliverable partial: an empty stream never opened a frame, and a
  // stream ending in a FLAG left len at 0. Everywhere else the stream may have
  // left a frame open and its flush is the one other emission allowed.
  const bool exactlyOne = useReset || stream.empty() || stream.back() == HDLC::FLAG;

  const size_t before = frames.size();
  for (size_t i = 0; i < goodLen; i++) {
    gByte = stream.size() + i;
    feeder.feed(good[i]);
  }
  const size_t emitted = frames.size() - before;
  FUZZ_ASSERT(emitted >= 1, "no frame recovered after the stream");
  if (exactlyOne)
    FUZZ_ASSERT(emitted == 1,
                "a frame fed into an empty parser produced %zu frames, not one", emitted);
  else
    FUZZ_ASSERT(emitted <= 2, "the recovery frame produced %zu flushes", emitted);
  FUZZ_ASSERT(frames.back().size() == payload.size(),
              "recovered frame is %zu bytes, framed payload was %zu",
              frames.back().size(), payload.size());
  FUZZ_ASSERT(memcmp(frames.back().data(), payload.data(), payload.size()) == 0,
              "recovered frame differs from the payload that was framed");

  // (6) Nothing outside the object was written.
  FUZZ_ASSERT(g.guardsIntact(), "the deframer wrote outside itself (guard band clobbered)");
}

typedef std::vector<uint8_t> (*Generator)(Rng&);

static void fuzz(unsigned gen, Generator make) {
  gGen = gen;
  for (unsigned i = 0; i < gIterations; i++) {
    gIter = i;
    Rng r(streamSeed(gSeed, gen, i));
    const std::vector<uint8_t> stream = make(r);
    runOneStream(stream, r);
  }
}

static void test_fuzz_uniform_random_bytes()   { fuzz(0, genRandomBytes); }
static void test_fuzz_mutated_valid_frames()   { fuzz(1, genMutatedFrame); }
static void test_fuzz_escape_alphabet()        { fuzz(2, genEscapeAlphabet); }

// ---------------------------------------------------------------------------
// Round trip
// ---------------------------------------------------------------------------

// The other half of the contract: what this firmware frames, this firmware
// deframes. Worst cases first and by name, because they are the ones where
// frame() writes two bytes for one and the buffer arithmetic has to be exact —
// an all-FLAG payload at the MTU is 1002 bytes on the wire out of a 500-byte
// packet. frameCapacity() is tight for any payload of nothing but FLAG and ESC
// bytes, in any mix and at any length, which is why the all-ESC case below is
// the same worst case rather than a milder one.
static void assertRoundTrip(const std::vector<uint8_t>& payload, const char* what) {
  std::vector<uint8_t> wire(HDLC::frameCapacity(payload.size()));
  const size_t n = HDLC::frame(payload.data(), payload.size(), wire.data(), wire.size());
  FUZZ_ASSERT(n > 0, "%s: HDLC::frame() refused a buffer of exactly frameCapacity()", what);

  HDLC::Deframer d;
  std::vector<std::vector<uint8_t>> frames;
  for (size_t i = 0; i < n; i++)
    d.feed(wire[i], [&](const uint8_t* p, size_t m) { frames.emplace_back(p, p + m); });

  FUZZ_ASSERT(frames.size() == 1, "%s: %zu bytes on the wire deframed to %zu frames, not one",
              what, n, frames.size());
  FUZZ_ASSERT(frames[0].size() == payload.size(),
              "%s: round trip returned %zu bytes for a %zu-byte payload",
              what, frames[0].size(), payload.size());
  FUZZ_ASSERT(memcmp(frames[0].data(), payload.data(), payload.size()) == 0,
              "%s: round trip changed the payload bytes", what);
  FUZZ_ASSERT(d.oversized() == 0, "%s: a well-formed frame was counted as oversized", what);
}

static void test_roundtrip_worst_case_payloads() {
  gGen = kGenCount;   // fixed payloads, not a corpus stream: no coordinates to print
  for (size_t len : { (size_t)1, (size_t)2, (size_t)499, (size_t)RNS_MTU }) {
    assertRoundTrip(std::vector<uint8_t>(len, HDLC::FLAG), "all-FLAG payload");
    assertRoundTrip(std::vector<uint8_t>(len, HDLC::ESC),  "all-ESC payload");
    assertRoundTrip(std::vector<uint8_t>(len, 0x00),       "all-zero payload");
  }
}

// And the same property over the seeded corpus, so the round trip is exercised
// on payload shapes nobody chose.
static void test_roundtrip_random_payloads() {
  gGen  = kGenRoundTrip;
  gByte = 0;   // the payload is the whole input here; there is no stream offset
  for (unsigned i = 0; i < gIterations; i++) {
    gIter = i;
    Rng r(streamSeed(gSeed ^ 0x52545253u, kGenRoundTrip, i));
    assertRoundTrip(randomPayload(r, RNS_MTU), "round trip");
  }
}

void setUp() {}
void tearDown() {}

int main(int argc, char** argv) {
  // argv[1] iterations, argv[2] seed: a developer runs a budget orders of
  // magnitude larger than CI's, or re-runs CI's exact failing corpus, without
  // touching the file. Absent, the CI budget above applies.
  if (argc > 1) {
    const long n = strtol(argv[1], nullptr, 0);
    if (n > 0) gIterations = (unsigned)n;
  }
  if (argc > 2) gSeed = (uint32_t)strtoul(argv[2], nullptr, 0);
  printf("test_hdlc_fuzz: seed=0x%08X iterations=%u per generator, streams up to %zu bytes\n",
         gSeed, gIterations, kMaxStream);

  UNITY_BEGIN();
  RUN_TEST(test_fuzz_uniform_random_bytes);
  RUN_TEST(test_fuzz_mutated_valid_frames);
  RUN_TEST(test_fuzz_escape_alphabet);
  RUN_TEST(test_roundtrip_worst_case_payloads);
  RUN_TEST(test_roundtrip_random_payloads);
  return UNITY_END();
}
